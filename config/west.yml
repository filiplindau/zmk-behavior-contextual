## config/west.yml
```yaml
manifest:

  remotes:
    - name: zmkfirmware
      url-base: https://github.com/zmkfirmware
    # Additional modules containing boards/shields/custom code can be listed here as well
    # See https://docs.zephyrproject.org/3.2.0/develop/west/manifest.html#projects
    - name: your_github
      url-base: https://github.com/filiplindau
  projects:
    - name: zmk
      remote: zmkfirmware
      revision: main
      import: app/west.yml
    - name: zmk-behavior-contextual
      remote: your_github
      revision: main # The branch name of your module repo
  self:
    path: config
```

## dts/bindings/behaviors/zmk,behavior-contextual.yaml
```yaml
description: Contextual Magic Key Behavior
compatible: "zmk,behavior-contextual"
include: one_param.yaml

properties:
  key-pairs:
    type: array
    required: true
    description: "Array of trigger and output keycodes. Example: <Q U>"
```
